## firmware/components/actuator_ctrl/Kconfig
```kconfig
menu "LabGuard hardware actuator control"

    config LABGUARD_ACTUATOR_FAN_GPIO
        int "Fan MOSFET gate GPIO"
        range -1 54
        default 5

    config LABGUARD_ACTUATOR_FAN_ACTIVE_LOW
        bool "Fan channel is active low"
        default n

    config LABGUARD_ACTUATOR_PUMP_GPIO
        int "Pump MOSFET gate GPIO"
        range -1 54
        default 6

    config LABGUARD_ACTUATOR_PUMP_ACTIVE_LOW
        bool "Pump channel is active low"
        default n

    config LABGUARD_ACTUATOR_LIGHT_GPIO
        int "Demo light MOSFET control GPIO"
        range -1 54
        default 32

    config LABGUARD_ACTUATOR_LIGHT_ACTIVE_LOW
        bool "Demo light channel is active low"
        default n

    config LABGUARD_ACTUATOR_LIGHT_DATA_GPIO
        int "LED strip data GPIO"
        range -1 54
        default 33

    config LABGUARD_ACTUATOR_LIGHT_LED_COUNT
        int "LED strip pixel count"
        range 1 256
        default 8
        help
            Number of WS2812/SK6812-compatible RGB pixels driven from the
            configured LED strip data GPIO.

endmenu
```

## firmware/components/audio_prompt/Kconfig
```kconfig
menu "LabGuard hardware audio prompt"

    config LABGUARD_AUDIO_PROMPT_SD_MOUNT_POINT
        string "Audio prompt SD card mount point"
        default "/sdcard"

    config LABGUARD_AUDIO_PROMPT_DIR
        string "Audio prompt directory on SD card"
        default "/audio"

    config LABGUARD_AUDIO_PROMPT_I2S_DOUT_GPIO
        int "MAX98357A DIN GPIO"
        range -1 54
        default 20

    config LABGUARD_AUDIO_PROMPT_I2S_BCLK_GPIO
        int "MAX98357A BCLK GPIO"
        range -1 54
        default 21

    config LABGUARD_AUDIO_PROMPT_I2S_WS_GPIO
        int "MAX98357A LRC/WS GPIO"
        range -1 54
        default 22

endmenu
```

## firmware/components/espdl_probe/Kconfig
```kconfig
menu "LabGuard ESP-DL probe"

config LABGUARD_ESPDL_PROBE_ENABLE
    bool "Enable isolated ESP-DL probe build"
    default n
    help
        Build the isolated ESP-DL probe component. This does not connect
        ESP-DL to camera inference, risk fusion, or actuator control.
        Keep this disabled for the normal demo flow. Enabling it links the
        ESP-DL C++ runtime and increases the app image size.

config LABGUARD_ESPDL_PROBE_RUN_ON_BOOT
    bool "Run isolated ESP-DL probe once on boot"
    depends on LABGUARD_ESPDL_PROBE_ENABLE
    default n
    help
        Run espdl_probe_run_once() from app_main(). Keep disabled for the
        normal LabGuard demo flow. Enable only for board-side model loading,
        model->test(), profile_memory(), and profile_module() validation.

choice LABGUARD_ESPDL_PROBE_LOAD_MODE
    prompt "ESP-DL probe model load mode"
    depends on LABGUARD_ESPDL_PROBE_ENABLE
    default LABGUARD_ESPDL_PROBE_LOAD_SDCARD
    help
        Select only the isolated probe model source. This does not wire
        ESP-DL into the existing inference or risk paths.

config LABGUARD_ESPDL_PROBE_LOAD_SDCARD
    bool "Load model from SD card"
    help
        Load the .espdl from a mounted SD card path. The current firmware
        mounts the onboard microSD at /sdcard before optionally running this
        probe. This avoids embedding the model into the app binary.

config LABGUARD_ESPDL_PROBE_LOAD_RODATA
    bool "Load model from flash rodata"
    help
        Embed firmware/components/espdl_probe/model/model.espdl with
        target_add_aligned_binary_data and load it from rodata. This is useful
        for isolated API validation, but it adds the full .espdl size to the
        app partition.

endchoice

config LABGUARD_ESPDL_PROBE_SDCARD_PATH
    string "SD card .espdl path"
    depends on LABGUARD_ESPDL_PROBE_ENABLE && LABGUARD_ESPDL_PROBE_LOAD_SDCARD
    default "/sdcard/model.espdl"
    help
        Path passed to dl::Model when MODEL_LOCATION_IN_SDCARD is selected.

config LABGUARD_ESPDL_PROBE_SORT_PROFILE_BY_LATENCY
    bool "Sort module profile by latency"
    depends on LABGUARD_ESPDL_PROBE_ENABLE
    default y
    help
        When a debug .espdl model is loaded, call profile_module(true) to
        print the slowest modules first.

endmenu
```

## firmware/components/sensor_reader/Kconfig
```kconfig
menu "LabGuard hardware sensor reader"

    config LABGUARD_SENSOR_I2C_ENABLE
        bool "Enable SHT3x/ENS160 I2C sensors"
        default y

    config LABGUARD_SENSOR_I2C_PORT
        int "SHT3x/ENS160 I2C port"
        range 0 2
        default 1

    config LABGUARD_SENSOR_I2C_SDA_GPIO
        int "SHT3x/ENS160 I2C SDA GPIO"
        range 0 54
        default 2

    config LABGUARD_SENSOR_I2C_SCL_GPIO
        int "SHT3x/ENS160 I2C SCL GPIO"
        range 0 54
        default 3

    config LABGUARD_SENSOR_I2C_FREQ_HZ
        int "SHT3x/ENS160 I2C clock speed"
        range 10000 400000
        default 100000

    config LABGUARD_SENSOR_I2C_INTERNAL_PULLUPS
        bool "Enable ESP32-P4 internal I2C pull-ups"
        default y

    config LABGUARD_SHT3X_ADDR
        hex "SHT3x I2C address"
        range 0x03 0x77
        default 0x44

    config LABGUARD_ENS160_ADDR
        hex "ENS160 I2C address"
        range 0x03 0x77
        default 0x53

    config LABGUARD_MQ2_ENABLE
        bool "Enable MQ-2 smoke / combustible gas sensor"
        default y

    config LABGUARD_MQ2_DO_GPIO
        int "MQ-2 DO input GPIO"
        depends on LABGUARD_MQ2_ENABLE
        range 0 54
        default 4

    config LABGUARD_MQ2_INTERNAL_PULLUP
        bool "Enable internal pull-up on MQ-2 DO line"
        depends on LABGUARD_MQ2_ENABLE
        default y

    config LABGUARD_MQ2_ACTIVE_LOW
        bool "MQ-2 DO alarm is active low"
        depends on LABGUARD_MQ2_ENABLE
        default y

    config LABGUARD_MQ2_ANALOG_ENABLE
        bool "Enable MQ-2 AO analog sampling"
        depends on LABGUARD_MQ2_ENABLE
        default n

    config LABGUARD_MQ2_AO_GPIO
        int "MQ-2 AO ADC GPIO"
        depends on LABGUARD_MQ2_ANALOG_ENABLE
        range 0 54
        default 1

    config LABGUARD_MQ2_ADC_SAMPLES
        int "MQ-2 AO averaged ADC sample count"
        depends on LABGUARD_MQ2_ANALOG_ENABLE
        range 1 64
        default 8

    config LABGUARD_MQ2_ALARM_THRESHOLD_MV
        int "MQ-2 AO alarm threshold in mV"
        depends on LABGUARD_MQ2_ANALOG_ENABLE
        range 0 3300
        default 1500

endmenu
```

## firmware/esp_indoor/components/actuator_ctrl/Kconfig
```kconfig
menu "LabGuard indoor actuator control"

    config LABGUARD_ACTUATOR_FAN_GPIO
        int "Fan MOSFET gate (IN1) GPIO"
        range -1 54
        default 5
        help
            Drives one channel of the 4-way MOSFET module. Active-high (3.3V
            turns the channel on, GND turns it off). Set to -1 to disable.

    config LABGUARD_ACTUATOR_FAN_ACTIVE_LOW
        bool "Fan channel is active low"
        default n
        help
            Most low-side N-MOS modules with optocoupler drive the load when
            the IN pin is high. Some opto-isolated boards expect active low.

    config LABGUARD_ACTUATOR_PUMP_GPIO
        int "Pump MOSFET gate (IN2) GPIO"
        range -1 54
        default 6
        help
            Drives a separate channel for the DC water pump. Set to -1 to
            disable.

    config LABGUARD_ACTUATOR_PUMP_ACTIVE_LOW
        bool "Pump channel is active low"
        default n

    config LABGUARD_ACTUATOR_ALARM_GPIO
        int "Alarm GPIO output"
        range -1 54
        default -1
        help
            Optional simple GPIO alarm output, for example a relay, active
            buzzer, or MOSFET channel. Set to -1 to disable. The addressable
            RGB strip below is controlled separately.

    config LABGUARD_ACTUATOR_ALARM_ACTIVE_LOW
        bool "Alarm GPIO output is active low"
        default n

    config LABGUARD_ACTUATOR_ALARM_STRIP_GPIO
        int "Addressable alarm light DI GPIO"
        range -1 54
        default 46
        help
            Data input pin for the 5V addressable RGB strip. Connect the strip
            DI pad to this GPIO and keep ESP32 GND common with the strip GND.
            Set to -1 to disable the strip output.

    config LABGUARD_ACTUATOR_ALARM_STRIP_LED_COUNT
        int "Addressable alarm light LED count"
        range 1 64
        default 4
        help
            Number of RGB LEDs connected in series on the strip.

    config LABGUARD_ACTUATOR_ALARM_STRIP_BRIGHTNESS
        int "Addressable alarm light brightness"
        range 1 255
        default 80
        help
            Red-channel brightness used during alarm flashing.

    config LABGUARD_ACTUATOR_ALARM_STRIP_BLINK_MS
        int "Addressable alarm light blink interval in ms"
        range 100 2000
        default 250

endmenu
```

## firmware/sdkconfig.defaults
```kconfig
CONFIG_IDF_TARGET="esp32p4"
CONFIG_PARTITION_TABLE_SINGLE_APP_LARGE=y
CONFIG_ESP_WIFI_REMOTE_ENABLED=y
CONFIG_SLAVE_IDF_TARGET_ESP32C6=y
CONFIG_ESP_HOSTED_CP_TARGET_ESP32C6=y
CONFIG_ESP_HOSTED_P4_DEV_BOARD_FUNC_BOARD=y
CONFIG_ESP_HOSTED_DFLT_TASK_FROM_SPIRAM=y
CONFIG_WIFI_RMT_STATIC_RX_BUFFER_NUM=16
CONFIG_WIFI_RMT_DYNAMIC_RX_BUFFER_NUM=64
CONFIG_WIFI_RMT_DYNAMIC_TX_BUFFER_NUM=64
CONFIG_WIFI_RMT_AMPDU_TX_ENABLED=y
CONFIG_WIFI_RMT_TX_BA_WIN=32
CONFIG_WIFI_RMT_AMPDU_RX_ENABLED=y
CONFIG_WIFI_RMT_RX_BA_WIN=32
CONFIG_LWIP_TCP_SND_BUF_DEFAULT=65534
CONFIG_LWIP_TCP_WND_DEFAULT=65534
CONFIG_LWIP_TCP_RECVMBOX_SIZE=64
CONFIG_LWIP_UDP_RECVMBOX_SIZE=64
CONFIG_LWIP_TCPIP_RECVMBOX_SIZE=64
CONFIG_LWIP_TCP_SACK_OUT=y
CONFIG_CAMERA_SC2336=y
CONFIG_CAM_CTRL_SPI_ENABLE=n
CONFIG_SPIRAM=y
CONFIG_SPIRAM_SPEED_250M=y
CONFIG_LABGUARD_SENSOR_I2C_PORT=1
CONFIG_LABGUARD_SENSOR_I2C_ENABLE=y
CONFIG_LABGUARD_SENSOR_I2C_SDA_GPIO=2
CONFIG_LABGUARD_SENSOR_I2C_SCL_GPIO=3
CONFIG_LABGUARD_MQ2_ACTIVE_LOW=y
CONFIG_LABGUARD_ACTUATOR_LIGHT_GPIO=32
CONFIG_LABGUARD_ACTUATOR_LIGHT_DATA_GPIO=33
CONFIG_LABGUARD_ACTUATOR_LIGHT_LED_COUNT=8
CONFIG_LABGUARD_AUDIO_PROMPT_I2S_WS_GPIO=22

# SC2336 native 1024x600 RAW8 matches the EK79007 panel and camera pipeline.
CONFIG_CAMERA_SC2336_MIPI_RAW8_1024X600_30FPS=y
CONFIG_CAMERA_SC2336_AUTO_DETECT_MIPI_INTERFACE_SENSOR=y
```

## firmware/sdkconfig.defaults.espdl_probe_sdcard
```kconfig
CONFIG_LABGUARD_ESPDL_PROBE_ENABLE=y
CONFIG_LABGUARD_ESPDL_PROBE_RUN_ON_BOOT=y
CONFIG_LABGUARD_ESPDL_PROBE_LOAD_SDCARD=y
# CONFIG_LABGUARD_ESPDL_PROBE_LOAD_RODATA is not set
CONFIG_LABGUARD_ESPDL_PROBE_SDCARD_PATH="/sdcard/model.espdl"
CONFIG_LABGUARD_ESPDL_PROBE_SORT_PROFILE_BY_LATENCY=y
```

## firmware/esp_indoor/components/hazard_infer/Kconfig
```kconfig
menu "LabGuard indoor hazard inference"

    config LABGUARD_HAZARD_ENABLE_ESPDL_BACKEND
        bool "Enable ESP-DL hazard detector backend"
        default y
        help
            Loads a .espdl fire/smoke detector from microSD when available.
            If the model file is missing or model load fails, firmware falls
            back to the existing provisional hazard inference path.

    config LABGUARD_HAZARD_MODEL_SDCARD_PATH
        string "ESP-DL model path on microSD"
        default "/sdcard/models/p4/lab_fire_smoke.espdl"
        help
            Absolute path to the packed or single-model .espdl artifact.
            Copy the converted model to the on-board microSD card before boot.

    config LABGUARD_HAZARD_SCORE_THRESHOLD_PERCENT
        int "Detection score threshold (%)"
        range 1 99
        default 45
        help
            Minimum detection confidence used before NMS for both fire and
            smoke classes.

    config LABGUARD_HAZARD_NMS_THRESHOLD_PERCENT
        int "Detection NMS threshold (%)"
        range 1 99
        default 45
        help
            IoU threshold used for non-maximum suppression.

    config LABGUARD_HAZARD_SMOKE_THRESHOLD_PERCENT
        int "Smoke alarm threshold (%)"
        range 1 99
        default 50
        help
            Final smoke confidence threshold used to set hazard.smoke=true.

    config LABGUARD_HAZARD_FLAME_THRESHOLD_PERCENT
        int "Flame alarm threshold (%)"
        range 1 99
        default 70
        help
            Final flame confidence threshold used to set hazard.flame=true.

    config LABGUARD_HAZARD_TOP_K
        int "Maximum kept detections"
        range 1 64
        default 12
        help
            Limits the number of retained detections after post-processing.

    config LABGUARD_HAZARD_MAX_INTERNAL_BYTES
        int "Preferred internal RAM budget for ESP-DL model"
        range 0 2097152
        default 0
        help
            Leave at 0 to let ESP-DL decide automatically. Increase this if
            you need to force more workspace into internal RAM for speed.

endmenu
```

## firmware/esp_indoor/main/Kconfig.projbuild
```kconfig
menu "LabGuard network"

    config LABGUARD_WIFI_SSID
        string "Wi-Fi SSID"
        default ""
        help
            2.4 GHz Wi-Fi SSID used by the indoor node.

    config LABGUARD_WIFI_PASSWORD
        string "Wi-Fi password"
        default ""
        help
            Wi-Fi password. Leave empty only for an open test network.

    config LABGUARD_MQTT_URI
        string "MQTT broker URI"
        default ""
        help
            MQTT broker URI, for example mqtt://192.168.1.10:1883.
            Leave empty to keep local-only serial logging.

endmenu
```

## firmware/esp_indoor/sdkconfig.defaults
```kconfig
CONFIG_ESP_MAIN_TASK_STACK_SIZE=8192
CONFIG_LOG_DEFAULT_LEVEL_INFO=y
CONFIG_FREERTOS_HZ=1000

CONFIG_PARTITION_TABLE_SINGLE_APP_LARGE=y

# ESP32-P4 Function EV Board uses the onboard ESP32-C6 as Wi-Fi co-processor.
CONFIG_ESP_HOST_WIFI_ENABLED=n
CONFIG_ESP_WIFI_REMOTE_ENABLED=y
CONFIG_ESP_WIFI_REMOTE_LIBRARY_HOSTED=y
CONFIG_SLAVE_IDF_TARGET_ESP32C6=y
CONFIG_ESP_HOSTED_ENABLED=y
CONFIG_ESP_HOSTED_CP_TARGET_ESP32C6=y
CONFIG_ESP_HOSTED_P4_DEV_BOARD_FUNC_BOARD=y
# CONFIG_ESP_HOSTED_SPI_HOST_INTERFACE is not set
CONFIG_ESP_HOSTED_SDIO_HOST_INTERFACE=y
CONFIG_ESP_HOSTED_SDIO_SLOT_1=y

# Fill these through `idf.py menuconfig` or sdkconfig.local before flashing.
CONFIG_LABGUARD_WIFI_SSID="李柯岑的iPhone"
CONFIG_LABGUARD_WIFI_PASSWORD="Ljl635415"
CONFIG_LABGUARD_MQTT_URI="mqtt://172.20.10.14:1883"

# Indoor environmental sensor I2C bus (shared with SC2336 camera SCCB)
CONFIG_LABGUARD_INDOOR_SENSOR_I2C_PORT=0
CONFIG_LABGUARD_INDOOR_SENSOR_I2C_SDA_GPIO=7
CONFIG_LABGUARD_INDOOR_SENSOR_I2C_SCL_GPIO=8
CONFIG_LABGUARD_INDOOR_SENSOR_I2C_FREQ_HZ=100000
CONFIG_LABGUARD_INDOOR_SENSOR_I2C_INTERNAL_PULLUPS=y
CONFIG_LABGUARD_INDOOR_SENSOR_I2C_SCAN=y
CONFIG_LABGUARD_INDOOR_SENSOR_I2C_AUTO_DETECT_PINS=y
CONFIG_LABGUARD_SHT3X_ADDR=0x44
CONFIG_LABGUARD_ENS160_ADDR=0x53

# MQ-2 smoke / combustible gas sensor (digital DO line)
CONFIG_LABGUARD_MQ2_ENABLE=y
CONFIG_LABGUARD_MQ2_DO_GPIO=4
CONFIG_LABGUARD_MQ2_ACTIVE_LOW=y
CONFIG_LABGUARD_MQ2_INTERNAL_PULLUP=y

# 4-channel MOSFET module gate pins (active-high by default)
CONFIG_LABGUARD_ACTUATOR_FAN_GPIO=5
CONFIG_LABGUARD_ACTUATOR_FAN_ACTIVE_LOW=n
CONFIG_LABGUARD_ACTUATOR_PUMP_GPIO=6
CONFIG_LABGUARD_ACTUATOR_PUMP_ACTIVE_LOW=n
CONFIG_LABGUARD_ACTUATOR_ALARM_GPIO=9
CONFIG_LABGUARD_ACTUATOR_ALARM_ACTIVE_LOW=n

# PSRAM is required for the MIPI-DSI frame buffer (1024*600*2 = 1.2MB)
CONFIG_SPIRAM=y
CONFIG_SPIRAM_MODE_HEX=y
CONFIG_SPIRAM_SPEED_250M=y

# SC2336 camera sensor: native 1024x600 RAW8 30fps so it matches the EK79007
# panel without needing an ISP scaler. The library's default 1280x720 produces
# a "failed to configure format conversion" error.
CONFIG_CAMERA_SC2336=y
CONFIG_CAMERA_SC2336_MIPI_RAW8_1024X600_30FPS=y
CONFIG_CAMERA_SC2336_AUTO_DETECT_MIPI_INTERFACE_SENSOR=y

# The esp_cam_sensor SPI sub-driver does not build cleanly on IDF 6.0 (calls
# spicommon_* APIs with the wrong signatures). We use the MIPI-CSI interface,
# not SPI, so disable the SPI sub-driver entirely to skip those translation
# units.
CONFIG_CAM_CTRL_SPI_ENABLE=n
```

## firmware/esp_outdoor/components/audio_prompt/Kconfig
```kconfig
menu "LabGuard outdoor audio prompts"

    config LABGUARD_AUDIO_PROMPT_I2S_WAV
        bool "Play voice prompts from SD card over I2S"
        default y
        help
            Play fixed PCM WAV prompt files from the mounted SD card through a
            MAX98357A-compatible I2S amplifier. If disabled, audio_prompt only
            records and logs the selected prompt.

    config LABGUARD_AUDIO_PROMPT_SD_MOUNT_POINT
        string "Audio prompt SD card mount point"
        default "/sdcard"
        depends on LABGUARD_AUDIO_PROMPT_I2S_WAV

    config LABGUARD_AUDIO_PROMPT_DIR
        string "Audio prompt directory on SD card"
        default "/audio"
        depends on LABGUARD_AUDIO_PROMPT_I2S_WAV

    config LABGUARD_AUDIO_PROMPT_I2S_DOUT_GPIO
        int "MAX98357A DIN GPIO"
        range -1 54
        default 20
        depends on LABGUARD_AUDIO_PROMPT_I2S_WAV

    config LABGUARD_AUDIO_PROMPT_I2S_BCLK_GPIO
        int "MAX98357A BCLK GPIO"
        range -1 54
        default 21
        depends on LABGUARD_AUDIO_PROMPT_I2S_WAV

    config LABGUARD_AUDIO_PROMPT_I2S_WS_GPIO
        int "MAX98357A LRC/WS GPIO"
        range -1 54
        default 22
        depends on LABGUARD_AUDIO_PROMPT_I2S_WAV

endmenu
```

## firmware/esp_outdoor/sdkconfig.defaults
```kconfig
CONFIG_ESP_MAIN_TASK_STACK_SIZE=8192
CONFIG_LOG_DEFAULT_LEVEL_INFO=y
CONFIG_FREERTOS_HZ=1000

# ESP32-P4 Function EV Board uses the onboard ESP32-C6 as Wi-Fi co-processor.
CONFIG_ESP_HOST_WIFI_ENABLED=n
CONFIG_ESP_WIFI_REMOTE_ENABLED=y
CONFIG_ESP_WIFI_REMOTE_LIBRARY_HOSTED=y
CONFIG_SLAVE_IDF_TARGET_ESP32C6=y
CONFIG_ESP_HOSTED_ENABLED=y
CONFIG_ESP_HOSTED_CP_TARGET_ESP32C6=y
CONFIG_ESP_HOSTED_P4_DEV_BOARD_FUNC_BOARD=y
CONFIG_ESP_HOSTED_SDIO_HOST_INTERFACE=y
CONFIG_ESP_HOSTED_SDIO_SLOT_1=y

# Fill these through `idf.py menuconfig` or sdkconfig.local before flashing.
CONFIG_LABGUARD_WIFI_SSID=""
CONFIG_LABGUARD_WIFI_PASSWORD=""
CONFIG_LABGUARD_MQTT_URI=""
```

## yolo/shiyanshianquan-espdl-poc/shiyanshianquan-espdl-poc/firmware/esp_indoor/components/sensor_reader/Kconfig
```kconfig
menu "LabGuard indoor sensor reader"

    config LABGUARD_INDOOR_SENSOR_I2C_PORT
        int "Indoor SHT3x/ENS160 I2C port"
        range 0 2
        default 0
        help
            ESP32-P4 has multiple I2C controllers. Use port 0 unless another
            component in this project already owns it.

    config LABGUARD_INDOOR_SENSOR_I2C_SDA_GPIO
        int "Indoor SHT3x/ENS160 I2C SDA GPIO"
        range 0 54
        default 23
        help
            Default follows the ESP32-P4 Function EV Board fly-line I2C SDA.
            Change this if your Dupont wire is connected to another GPIO.

    config LABGUARD_INDOOR_SENSOR_I2C_SCL_GPIO
        int "Indoor SHT3x/ENS160 I2C SCL GPIO"
        range 0 54
        default 22
        help
            Default follows the ESP32-P4 Function EV Board fly-line I2C SCL.
            Change this if your Dupont wire is connected to another GPIO.

    config LABGUARD_INDOOR_SENSOR_I2C_FREQ_HZ
        int "Indoor SHT3x/ENS160 I2C clock speed"
        range 10000 400000
        default 100000

    config LABGUARD_INDOOR_SENSOR_I2C_INTERNAL_PULLUPS
        bool "Enable ESP32-P4 internal I2C pull-ups"
        default y
        help
            Most SHT3x and ENS160 breakout boards already include pull-up
            resistors. Keeping the weak internal pull-ups enabled helps with
            breadboard wiring and does not replace proper external pull-ups.

    config LABGUARD_INDOOR_SENSOR_I2C_SCAN
        bool "Scan I2C bus at boot"
        default y
        help
            Prints every ACKed 7-bit address at boot. This is useful while
            checking SHT3x and ENS160 wiring.

    config LABGUARD_INDOOR_SENSOR_I2C_AUTO_DETECT_PINS
        bool "Auto-detect common ESP32-P4 Function EV Board I2C pins"
        default y
        help
            Tries the configured pins first, then common Function EV Board
            mappings: fly-line GPIO23/GPIO22, FIB GPIO7/GPIO8, and sample
            GPIO31/GPIO34.

    config LABGUARD_SHT3X_ADDR
        hex "SHT3x I2C address"
        range 0x03 0x77
        default 0x44
        help
            SHT30/SHT31/SHT35 modules are usually 0x44. Some boards can be
            configured to 0x45.

    config LABGUARD_ENS160_ADDR
        hex "ENS160 I2C address"
        range 0x03 0x77
        default 0x53
        help
            DFRobot Gravity ENS160 is commonly 0x53 by default and can be
            switched to 0x52 with the ADDR selector.

    config LABGUARD_MQ2_ENABLE
        bool "Enable MQ-2 smoke / combustible gas sensor"
        default y

    config LABGUARD_MQ2_DO_GPIO
        int "MQ-2 DO (digital threshold) input GPIO"
        depends on LABGUARD_MQ2_ENABLE
        range 0 54
        default 4
        help
            Connect MQ-2 module DO pin here. Use a level shifter or voltage
            divider if the module is powered from 5V, since the comparator
            output rail follows VCC.

    config LABGUARD_MQ2_ACTIVE_LOW
        bool "MQ-2 DO is active low"
        depends on LABGUARD_MQ2_ENABLE
        default y
        help
            Most MQ-2 breakout boards drive DO low when the gas concentration
            crosses the threshold set by the on-board potentiometer.

    config LABGUARD_MQ2_INTERNAL_PULLUP
        bool "Enable internal pull-up on MQ-2 DO line"
        depends on LABGUARD_MQ2_ENABLE
        default y

endmenu
```

## yolo/shiyanshianquan-espdl-poc/shiyanshianquan-espdl-poc/firmware/esp_indoor/sdkconfig.defaults.espdl_sdcard_poc
```kconfig
# Non-default ESP-DL SD-card probe POC overlay.
# Use only with an isolated build directory; do not merge into normal defaults.

CONFIG_LABGUARD_ESPDL_PROBE_ENABLE=y
CONFIG_LABGUARD_ESPDL_PROBE_RUN_ON_BOOT=y
# CONFIG_LABGUARD_ESPDL_PROBE_LOAD_RODATA is not set
CONFIG_LABGUARD_ESPDL_PROBE_LOAD_SDCARD=y
CONFIG_LABGUARD_ESPDL_PROBE_SDCARD_PATH="/sdcard/model.espdl"
CONFIG_LABGUARD_ESPDL_PROBE_SORT_PROFILE_BY_LATENCY=y

# Minimize the POC image to measure the lower bound of ESP-DL runtime size.
# CONFIG_COMPILER_OPTIMIZATION_DEBUG is not set
CONFIG_COMPILER_OPTIMIZATION_SIZE=y

# ESP-DL pixel conversion helpers are not used by this isolated model->test()
# probe, so they are disabled in this non-default size experiment.
# CONFIG_PIX_CVT_RGB565_TO_RGB565_SUPPORT is not set
# CONFIG_PIX_CVT_RGB565_TO_RGB888_SUPPORT is not set
# CONFIG_PIX_CVT_RGB565_TO_GRAY_SUPPORT is not set
# CONFIG_PIX_CVT_RGB565_TO_HSV_SUPPORT is not set
# CONFIG_PIX_CVT_RGB888_TO_RGB888_SUPPORT is not set
# CONFIG_PIX_CVT_RGB888_TO_RGB565_SUPPORT is not set
# CONFIG_PIX_CVT_RGB888_TO_GRAY_SUPPORT is not set
# CONFIG_PIX_CVT_RGB888_TO_HSV_SUPPORT is not set
# CONFIG_PIX_CVT_GRAY_TO_GRAY_SUPPORT is not set
# CONFIG_PIX_CVT_HSV_TO_HSV_MASK_SUPPORT is not set
# CONFIG_PIX_CVT_YUV_TO_RGB888_SUPPORT is not set
# CONFIG_PIX_CVT_YUV_TO_RGB565_SUPPORT is not set
# CONFIG_PIX_CVT_YUV_TO_GRAY_SUPPORT is not set
# CONFIG_PIX_CVT_YUV_TO_HSV_SUPPORT is not set
# CONFIG_PIX_CVT_YUV_TO_YUV_SUPPORT is not set
```
